## imx6ull/src/cjx_uboot/uboot-imx-rel_imx_4.1.15_2.1.0_ga/board/freescale/mx6ull_cjx_emmc/Kconfig
```kconfig
if TARGET_MX6ULL_CJX_EMMC 

config SYS_BOARD
	default "mx6ull_cjx_emmc"

config SYS_VENDOR
	default "freescale"

config SYS_SOC
	default "mx6"

config SYS_CONFIG_NAME
	default "mx6ull_cjx_emmc"

endif
```

## imx6ull/src/cjx_uboot/uboot-imx-rel_imx_4.1.15_2.1.0_ga/board/freescale/mx6ull_cjx_nand/Kconfig
```kconfig
if TARGET_MX6ULL_CJX_NAND 

config SYS_BOARD
	default "mx6ull_cjx_nand"

config SYS_VENDOR
	default "freescale"

config SYS_SOC
	default "mx6"

config SYS_CONFIG_NAME
	default "mx6ull_cjx_nand"


endif
```
